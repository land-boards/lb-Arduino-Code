// https://note.com/solder_state/n/nca6a1dec3921
//
// Seeed XIAO RP2040 equipped with the Rasberry pi RP2040
//
// Digital VCO with three modes: Wavefold, FM and AM.
// The cost of audio output is reduced by using PWM.
// Each mode has eight built-in waveforms.

// FREQ POT : Adjust the frequency. Since it is for tuning, the frequency range that can be adjusted is narrow.
// MOD POT : Adjusted the modulation effect.
// MODE SW : toggle switch to switch
// modeOCT SW : Switch octaves. Three ranges of -1,0,+1.
// PUSH SW : Switch the timbre. 8 tones to choose from in each mode.

// MOD CV : Adjusts the modulation level. The input range is 0-5V.
// V/oct : Frequency controlled. The input range is 0-5V and the resolution is 10bit.
// OUT: Audio output, output range is 5Vp-p.

#include <hardware/pwm.h>

int   k = 1;
float AM_mod = 1;           // AM modulation rate
float f = 0;
int   slice_num = 0;
float osc_freq = 0;
bool  push_sw, old_push_sw; // push sw
float mod = 0;
int   wavetable[256];       // 1024 resolution, 256 rate
float mod_wavetable[256];   // 1st modulated wavetable
int   mod2_wavetable[256];  // 2nd modulated wavetable
float calb = 1.15;          // Calibration for reduce resistance error
int   adc, freq_pot, oct_sw, mode;
int   waveform = 0;
int   f0 = 35;              // Base osc frequency
long  timer = 0;//use for making AM sinewave

const static float voctpow[1230] = {    //Covers 6(=1230) octaves. If it is 1230 or more, the operation becomes unstable.
  0,  0.004882, 0.009765, 0.014648, 0.019531, 0.024414, 0.029296, 0.034179, 0.039062, 0.043945, 0.048828, 0.05371,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 6.000976,
};
float freq_table[2048];

//void setup1() {
//}

#define OCT_UP_BUTTON 0
#define OCT_DOWN_BUTTON 1
#define TIMBRE_BUTTON 6
#define MODE_UP_BUTTON 3
#define MODE_DOWN_BUTTON 4


void setup()
{
  //  Serial.begin(115200);
  //  while (!Serial) {
  //    ; // wait for serial port to connect. Needed for native USB
  //  }
  pinMode(OCT_UP_BUTTON, INPUT_PULLUP);     //oct select up
  pinMode(OCT_DOWN_BUTTON, INPUT_PULLUP);   //oct select down
  pinMode(TIMBRE_BUTTON, INPUT_PULLUP);     //push sw
  pinMode(MODE_UP_BUTTON, INPUT_PULLUP);    //mode select up
  pinMode(MODE_DOWN_BUTTON, INPUT_PULLUP);  //mode select down
  timer = micros();

  table_set();//set wavetable
  //-------------------octave select-------------------------------
  for (int i = 0; i < 1230; i++) {  //Covers 6(=1230) octaves. If it is 1230 or more, the operation becomes unstable.
    freq_table[i] = f0 * pow(2, (voctpow[i]));
  }
  for (int i = 0; i < 2048 - 1230; i++) {
    freq_table[i + 1230] = 6;
  }

  //-------------------PWM setting-------------------------------
  gpio_set_function(2, GPIO_FUNC_PWM);// set GP2 function PWM
  slice_num = pwm_gpio_to_slice_num(2);// GP2 PWM slice

  pwm_clear_irq(slice_num);
  pwm_set_irq_enabled(slice_num, true);
  irq_set_exclusive_handler(PWM_IRQ_WRAP, on_pwm_wrap);
  irq_set_enabled(PWM_IRQ_WRAP, true);

  //set PWM frequency
  pwm_set_clkdiv(slice_num, 1);//=sysclock/((resolution+1)*frequency)
  pwm_set_wrap(slice_num, 1023);//resolutio
  pwm_set_enabled(slice_num, true);//PWM output enable
  //  Serial.println("Setup Done");
}

void  on_pwm_wrap() {
  pwm_clear_irq(slice_num);
  f = f + osc_freq;
  if (f > 255) {
    f = 0;
  }
  int k = (int)f;
  pwm_set_chan_level(slice_num, PWM_CHAN_A, mod2_wavetable[k] + 511);
}

void loop()
{
  old_push_sw = push_sw;
  //  Serial.println("Reached loop()");

  //-------------------octave select-------------------------------
  if (digitalRead(OCT_UP_BUTTON) == 1 && digitalRead(OCT_DOWN_BUTTON) == 1) {
    oct_sw = 1;
  }
  else if (digitalRead(OCT_UP_BUTTON) == 0 && digitalRead(OCT_DOWN_BUTTON) == 1) {
    oct_sw = 3;
    //    Serial.println("Oct Up");
  }
  else if (digitalRead(OCT_UP_BUTTON) == 1 && digitalRead(OCT_DOWN_BUTTON) == 0) {
    oct_sw = 0;
    //    Serial.println("Oct Down");
  }

  //  -------------------mode select-------------------------------
  if (digitalRead(MODE_DOWN_BUTTON) == 1 && digitalRead(MODE_UP_BUTTON) == 1) {
    mode = 1;   // FM
  }
  else if (digitalRead(MODE_DOWN_BUTTON) == 0 && digitalRead(MODE_UP_BUTTON) == 1) {
    mode = 0;   // AM
    //    Serial.println("Mode=AM");
  }
  else if (digitalRead(MODE_DOWN_BUTTON) == 1 && digitalRead(MODE_UP_BUTTON) == 0) {
    mode = 2;   // Wavefold
    //    Serial.println("Mode=Wavefold");
  }

  //  -------------------frequeny calculation-------------------------------
  adc = analogRead(26) * calb;      //Correct resistance errors
  adc = constrain(adc , 0, 1225);   //Covers 6(=1220) octaves. If it is 1230 or more, the operation becomes unstable.
  freq_pot = map(analogRead(27), 0, 1023, 0, 127);
  osc_freq = freq_table[adc + freq_pot]; // V/oct apply
  osc_freq = 256 * osc_freq / 122070 * (1 + oct_sw);

  //  -------------------mod parameter set-------------------------------
  if (mode == 0) {//fold
    mod = constrain(analogRead(29) + analogRead(28), 0, 1023) * 0.0036 + 0.90; //28 is CV , 29 is pot
  }
  else if (mode == 1) {//FM
    mod = constrain(analogRead(29) + analogRead(28), 0, 1023) / 8;
  }
  else if (mode == 2) {//AM
    mod = 1023 - constrain(analogRead(29) + analogRead(28), 0, 1023) ;
  }

  //  -------------------push sw-------------------------------
  push_sw = digitalRead(TIMBRE_BUTTON);
  if (push_sw == 0 && old_push_sw == 1) {//when push sw ON
    waveform++;//change waveform
    //    Serial.print("Waveform=");
    //    Serial.println(waveform);

    if (waveform > 7) {
      waveform = 0;
    }
    if (mode == 0 || mode == 2) {
      table_set();
    }
  }
  //}

  //void loop1() {//modulation
  if (mode == 0 ) {//wavefold
    for (int i = 0; i < 256; i++) {
      mod_wavetable[i] = wavetable[i] * mod;
    }
    for (int i = 0; i < 256; i++) {  //fold
      if (mod_wavetable[i] > 511 && mod_wavetable[i] < 1023 + 512) {
        mod2_wavetable[i] = 1024 - mod_wavetable[i];
      }
      else if (mod_wavetable[i] < -512 && mod_wavetable[i] > -1024 - 512) {
        mod2_wavetable[i] = -1023 - mod_wavetable[i];
      }
      else if (mod_wavetable[i] < -1024 - 511) {
        mod2_wavetable[i] = 2048 + mod_wavetable[i];
      }
      else if (mod_wavetable[i] > 1023 + 511) {
        mod2_wavetable[i] = -2047 + mod_wavetable[i];
      }
      else {
        mod2_wavetable[i] = mod_wavetable[i] ;
      }
    }
  }
  else if (mode == 1) {//FM
    switch  (waveform) {
      case 0:
        for (int i = 0; i < 256; i++) {  //FM1
          mod2_wavetable[i] = (sin(2 * M_PI * i  / 256 + mod / 128 * sin(2 * M_PI * 3 * i  / 256)) ) * 511;
        }
        break;

      case 1:
        for (int i = 0; i < 256; i++) {  //FM2
          mod2_wavetable[i] = (sin(2 * M_PI * i  / 256 + mod / 128 * sin(2 * M_PI * 3 * i  / 256 + mod / 128 * sin(2 * M_PI * 3 * i  / 256))) ) * 511;
        }
        break;

      case 2:
        for (int i = 0; i < 256; i++) {  //FM3
          mod2_wavetable[i] = (sin(2 * M_PI * i  / 256 + mod / 128 * sin(2 * M_PI * 5 * i  / 256 + mod / 128 * sin(2 * M_PI * 7 * i  / 256))) ) * 511;
        }
        break;

      case 3:
        for (int i = 0; i < 256; i++) {  //FM4
          mod2_wavetable[i] = (sin(2 * M_PI * i  / 256 + mod / 128 * sin(2 * M_PI * 9 * i  / 256 + mod / 128 * sin(2 * M_PI * 5 * i  / 256))) ) * 511;
        }
        break;

      case 4:
        for (int i = 0; i < 256; i++) {  //FM5
          mod2_wavetable[i] = ((sin(2 * M_PI * i  / 256 + mod / 128 * sin(2 * M_PI * 19 * i  / 256)) ) + (sin(2 * M_PI * 3 * i  / 256 + mod / 128 * sin(2 * M_PI * 7 * i  / 256)) )) / 2 * 511;
        }
        break;

      case 5:
        for (int i = 0; i < 256; i++) {  //FM6
          mod2_wavetable[i] = ((sin(2 * M_PI * i  / 256 + mod / 128 * sin(2 * M_PI * 7 * i  / 124)) ) + (sin(2 * M_PI * 9 * i  / 368 + mod / 128 * sin(2 * M_PI * 11 * i  / 256)) )) * 511;
        }
        break;

      case 6:
        for (int i = 0; i < 256; i++) {  //FM7
          mod2_wavetable[i] = ((sin(2 * M_PI * i  / 256 + mod / 128 * sin(2 * M_PI * 13 * i  / 256)) ) + (sin(2 * M_PI * 17 * i  / 111 + mod / 128 * sin(2 * M_PI * 19 * i  / 89)) )) * 511;
        }
        break;

      case 7:
        for (int i = 0; i < 256; i++) {  //FM8
          mod2_wavetable[i] = (sin(2 * M_PI * i  / 256 + mod / 128 * sin(2 * M_PI * 11 * i  / 124 + mod / 128 * sin(2 * M_PI * 7 * i  / 333 + mod / 128 * sin(2 * M_PI * 9 * i  / 56)))) )  * 511;
        }
        break;
    }
  }

  else if (mode == 2) {//AM
    if (timer + mod <= micros()) {
      k++;
      if (k > 63) {
        k = 0;
      }
      AM_mod = sin( 2 * M_PI * k  / 63);//make modulation sine wave
      for (int i = 0; i < 255 ; i++) {
        mod2_wavetable[i] = wavetable[i] * AM_mod;//multiply AM sine wave
      }
      timer = micros();
    }
  }

}

void table_set() {//make wavetable

  if (mode == 0) { //wavefold
    switch  (waveform) {
      case 0:
        for (int i = 0; i < 256; i++) {  //saw
          wavetable[i] = i * 4 - 512;
        }
        break;

      case 1:
        for (int i = 0; i < 256; i++) {  //sin
          wavetable[i] = (sin(2 * M_PI * i  / 256)) * 511;
        }
        break;

      case 2:
        for (int i = 0; i < 128; i++) {  //squ
          wavetable[i] = 511;
          wavetable[i + 128] = -511;
        }
        break;

      case 3:
        for (int i = 0; i < 128; i++) {  //tri
          wavetable[i] = i * 8 - 511;
          wavetable[i + 128] = 511 - i * 8;
        }
        break;

      case 4:
        for (int i = 0; i < 128; i++) {  //oct saw
          wavetable[i] = i * 4 - 512 + i * 2;
          wavetable[i + 128] = i * 2 - 256 + i * 4;
        }
        break;

      case 5:
        for (int i = 0; i < 256; i++) {  //FM1
          wavetable[i] = (sin(2 * M_PI * i  / 256 + sin(2 * M_PI * 3 * i  / 256)) ) * 511;
        }
        break;

      case 6:
        for (int i = 0; i < 256; i++) {  //FM2
          wavetable[i] = (sin(2 * M_PI * i  / 256 + sin(2 * M_PI * 7 * i  / 256))) * 511;
        }
        break;

      case 7:
        for (int i = 0; i < 256; i++) {  //FM3
          wavetable[i] = (sin(2 * M_PI * i  / 256 + sin(2 * M_PI * 4 * i  / 256 + sin(2 * M_PI * 11 * i  / 256)))) * 511;
        }
        break;
    }
  }
  else if (mode == 2) { //AM
    switch  (waveform) {
      case 0:
        for (int i = 0; i < 256; i++) {  //saw
          wavetable[i] = (sin(2 * M_PI * i  / 256)) * 511;
        }
        break;

      case 1:
        for (int i = 0; i < 256; i++) {  //fm1
          wavetable[i] = (sin(2 * M_PI * i  / 256 + sin(2 * M_PI * 3 * i  / 256)) ) * 511;
        }
        break;

      case 2:
        for (int i = 0; i < 256; i++) {  //fm2
          wavetable[i] = (sin(2 * M_PI * i  / 256 + sin(2 * M_PI * 5 * i  / 256)) ) * 511;
        }
        break;

      case 3:
        for (int i = 0; i < 256; i++) {  //fm3
          wavetable[i] = (sin(2 * M_PI * i  / 256 + sin(2 * M_PI * 4 * i  / 256 + sin(2 * M_PI * 11 * i  / 256)))) * 511;
        }
        break;

      case 4:
        for (int i = 0; i < 256; i++) {  //non-integer multiplets fm1
          wavetable[i] = (sin(2 * M_PI * i  / 256 + sin(2 * M_PI * 1.28 * i  / 256)) ) * 511;
        }
        break;

      case 5:
        for (int i = 0; i < 256; i++) {  //non-integer multiplets fm2
          wavetable[i] = (sin(2 * M_PI * i  / 256 + sin(2 * M_PI * 3.19 * i  / 256)) ) * 511;
        }
        break;

      case 6:
        for (int i = 0; i < 256; i++) {  //non-integer multiplets fm3
          wavetable[i] = (sin(2 * M_PI * i  / 256 + sin(2 * M_PI * 2.3 * i  / 256 + sin(2 * M_PI * 7.3 * i  / 256)))) * 511;
        }
        break;

      case 7:
        for (int i = 0; i < 256; i++) {  //non-integer multiplets fm3
          wavetable[i] = (sin(2 * M_PI * i  / 256 + sin(2 * M_PI * 6.3 * i  / 256 + sin(2 * M_PI * 11.3 * i  / 256)))) * 511;
        }
        break;
    }
  }
}
